## patches-3.7/arch/unicore64/Kconfig
```kconfig
config UNICORE64
	def_bool y
	select HAVE_GENERIC_HARDIRQS
	select HAVE_KERNEL_GZIP
	select HAVE_KERNEL_BZIP2
	select HAVE_KERNEL_LZO
	select HAVE_KERNEL_LZMA
	select HAVE_MEMBLOCK
	select HAVE_DMA_ATTRS
	select ARCH_WANT_FRAME_POINTERS
	select GENERIC_IRQ_SHOW
	select GENERIC_KERNEL_THREAD
	select GENERIC_KERNEL_EXECVE
	select GENERIC_SMP_IDLE_THREAD
	select USE_GENERIC_SMP_HELPERS if SMP
	select OF
	select OF_EARLY_FLATTREE
	select NO_BOOTMEM
	help
	  UniCore-64 is 64-bit Instruction Set Architecture,
	  including a series of low-power-consumption RISC chip
	  designs licensed by PKUnity Ltd.
	  Please see web page at <http://www.pkunity.com/>.

config 64BIT
	def_bool y
	select GENERIC_ATOMIC64

config ARCH_DMA_ADDR_T_64BIT
	def_bool y

config RWSEM_GENERIC_SPINLOCK
	def_bool y

config GENERIC_CLOCKEVENTS
	def_bool y

config GENERIC_HWEIGHT
	def_bool y

config GENERIC_CALIBRATE_DELAY
	def_bool y

source "init/Kconfig"

menu "Processor and System Type"

config SMP
	bool "Symmeric Multi-Processing"
	help
	  This enables support for systems with more than one CPU. If you have
	  a system with only one CPU, like most personal computers, say N. If
	  you have a system with more than one CPU, say Y.

	  If you say N here, the kernel will run on single and multiprocessor
	  machines, but will use only one CPU of a multiprocessor machine. If
	  you say Y here, the kernel will run on many, but not all, single
	  processor machines. On a single processor machine, the kernel will
	  run faster if you say N here.

	  See also the SMP-HOWTO available at
	  <http://tldp.org/HOWTO/SMP-HOWTO.html>.

	  If you don't know what to do here, say N.

config NR_CPUS
	int "Maximum number of CPUs (2-4)"
	depends on SMP
	default "2"

config MMU
	def_bool y

source "arch/unicore64/mm/Kconfig"

source "kernel/Kconfig.hz"

comment "Board and System Features"

config ARCH_FPGA
	bool "FPGA Specific Board/System"
	help
	  ONLY enabled this option when debugging and running in FPGA board.

	  If unsure, say N.

config ARCH_PUV3
	def_bool n

config ARCH_PUV4
	def_bool y

endmenu

menu "Kernel Features"

source "kernel/time/Kconfig"

source "mm/Kconfig"

endmenu

menu "Boot options"

config CMDLINE
	string "Default kernel command string"
	default ""

config CMDLINE_FORCE
	bool "Always use the default kernel command string"
	depends on CMDLINE != ""
	help
	  Always use the default kernel command string, even if the boot
	  loader passes other arguments to the kernel.
	  This is useful if you cannot or don't want to change the
	  command-line options your boot loader passes to the kernel.

	  If unsure, say N.

endmenu

menu "Userspace binary formats"

source "fs/Kconfig.binfmt"

endmenu

source "net/Kconfig"

source "drivers/Kconfig"

source "fs/Kconfig"

source "lib/Kconfig"

source "arch/unicore64/Kconfig.debug"
```

## patches-3.7/arch/unicore64/Kconfig.debug
```kconfig
menu "Kernel hacking"

source "lib/Kconfig.debug"

config DEBUG_OCD
	bool "Kernel low-level debugging via On-Chip-Debugger"
	depends on DEBUG_KERNEL
	help
	  Say Y here if you want the debug print routines to direct their
	  output to the UniCore On-Chip-Debugger channel.

config DEBUG_MCOUNT
	bool "Print out useful debug information for each function by mcount"
	depends on DEBUG_OCD
	help
	  Say Y here if you want the debug information for each functions
	  under arch/unicore64/kernel and arch/unicore64/mm dirs.

config EARLY_PRINTK
	def_bool DEBUG_OCD
	depends on PRINTK
	help
	  Write kernel log output directly into the ocd or to a serial port.

	  This is useful for kernel debugging when your machine crashes very
	  early before the console code is initialized. For normal operation
	  it is not recommended because it looks ugly and doesn't cooperate
	  with klogd/syslogd or the X server. You should normally N here,
	  unless you want to debug such a crash.

config OCD_CONSOLE
	bool
	depends on VGA_CONSOLE!=y && FRAMEBUFFER_CONSOLE!=y && DEBUG_OCD
	default y

endmenu
```

## patches-3.7/arch/unicore64/configs/unicore64_defconfig
```kconfig
### General setup
CONFIG_LOCALVERSION="-uc64"
#	Initial RAM filesystem and RAM disk (initramfs/initrd) support
CONFIG_BLK_DEV_INITRD=y
CONFIG_INITRAMFS_SOURCE="~/UniCore64/initramfs/initramfs_config.busybox"

### Processor and System Type
CONFIG_SMP=n
#	Processor Features
CONFIG_ARCH_FPGA=y
CONFIG_CPU_ICACHE_DISABLE=n
CONFIG_CPU_DCACHE_DISABLE=n

CONFIG_HZ_100=y

# Device Drivers
#	Hardware I/O ports
CONFIG_SERIO_I8042=y
#	Console display driver support
CONFIG_FRAMEBUFFER_CONSOLE=y
CONFIG_VGA_CONSOLE=n
CONFIG_FONTS=y
CONFIG_FONT_8x8=y
CONFIG_FONT_8x16=y
CONFIG_INPUT=y

CONFIG_VT=y
CONFIG_VT_CONSOLE=y

#       Graphics support
CONFIG_FB=y
CONFIG_FB_SYS_FILLRECT=y
CONFIG_FB_SYS_COPYAREA=y
CONFIG_FB_SYS_IMAGEBLIT=y
CONFIG_FB_SYS_FOPS=y
CONFIG_FB_PUV4_DE2=y

# SCSI device support
CONFIG_SCSI=y
CONFIG_SCSI_DMA=y
#Disable SWIOTLB for 3.7!
CONFIG_SWIOTLB=n

CONFIG_BLK_DEV_SD=y

# SCSI Transports
CONFIG_ATA=y
CONFIG_ATA_VERBOSE_ERROR=y
CONFIG_ATA_SFF=y
CONFIG_PATA_BK3710=y

#
# File systems
#
CONFIG_EXT2_FS=y
CONFIG_FS_MBCACHE=y

### Kernel hacking
CONFIG_DEBUG_KERNEL=y
CONFIG_DEBUG_OCD=y
CONFIG_DEBUG_MCOUNT=n

### Boot options
CONFIG_CMDLINE="earlyprintk=ocd,keep ignore_loglevel root=/dev/ram0 rw video=unifb:640x480@60-16"

### Kernel hacking
```

## patches-3.7/arch/unicore64/configs/unicore64_smp_defconfig
```kconfig
### General setup
CONFIG_LOCALVERSION="-uc64"
#	Initial RAM filesystem and RAM disk (initramfs/initrd) support
CONFIG_BLK_DEV_INITRD=y
CONFIG_INITRAMFS_SOURCE="~/UniCore64/initramfs/initramfs_config.busybox"

### Processor and System Type
CONFIG_SMP=y
#	Processor Features
CONFIG_ARCH_FPGA=y
CONFIG_CPU_ICACHE_DISABLE=n
CONFIG_CPU_DCACHE_DISABLE=n

# Device Drivers
#	Hardware I/O ports
CONFIG_SERIO_I8042=y
#	Console display driver support
CONFIG_FRAMEBUFFER_CONSOLE=y
CONFIG_VGA_CONSOLE=n
CONFIG_FONTS=y
CONFIG_FONT_8x8=y
CONFIG_FONT_8x16=y
CONFIG_INPUT=y

CONFIG_VT=y
CONFIG_VT_CONSOLE=y

#       Graphics support
CONFIG_FB=y
CONFIG_FB_SYS_FILLRECT=y
CONFIG_FB_SYS_COPYAREA=y
CONFIG_FB_SYS_IMAGEBLIT=y
CONFIG_FB_SYS_FOPS=y
CONFIG_FB_PUV4_DE2=y

### Kernel hacking
CONFIG_DEBUG_KERNEL=y
CONFIG_DEBUG_OCD=y
CONFIG_DEBUG_MCOUNT=n

### Boot options
CONFIG_CMDLINE="earlyprintk=ocd ignore_loglevel root=/dev/ram0 rw video=unifb:640x480@60-32"

### Kernel hacking
```

## patches-3.7/arch/unicore64/configs/unicore64_smp_qemu_defconfig
```kconfig
### General setup
CONFIG_LOCALVERSION="-uc64"
#	Initial RAM filesystem and RAM disk (initramfs/initrd) support
CONFIG_BLK_DEV_INITRD=y
CONFIG_INITRAMFS_SOURCE="~/UniCore64/initramfs/initramfs_config.busybox"

### Processor and System Type
CONFIG_SMP=y
#	Processor Features
CONFIG_ARCH_FPGA=y
CONFIG_CPU_ICACHE_DISABLE=y
CONFIG_CPU_DCACHE_DISABLE=y

# Device Drivers
#	Hardware I/O ports
CONFIG_SERIO_I8042=y
#	Console display driver support
CONFIG_VGA_CONSOLE=n

### Kernel hacking
CONFIG_DEBUG_KERNEL=y
CONFIG_DEBUG_OCD=y
CONFIG_DEBUG_MCOUNT=n

### Boot options
CONFIG_CMDLINE="earlyprintk=ocd ignore_loglevel root=/dev/ram0 rw"

### Kernel hacking
```

## patches-3.7/arch/unicore64/mm/Kconfig
```kconfig
comment "Processor Type"

# Select CPU types depending on the architecture selected.  This selects
# which CPUs we support in the kernel image, and the compiler instruction
# optimiser behaviour.

config CPU_UCV3
	def_bool y

comment "Processor Features"

config CPU_ICACHE_DISABLE
	bool "Disable I-Cache (I-bit)"
	help
	  Say Y here to disable the processor instruction cache.
	  ONLY used when debugging or special circumstance.
	  It unsure, say N.
	  Please see web page at <http://www.pkunity.com/>

config CPU_DCACHE_DISABLE
	bool "Disable D-Cache (D-bit)"
	help
	  Say Y here to disable the processor data cache.
	  ONLY used when debugging or special circumstance.
	  It unsure, say N.
	  Please see web page at <http://www.pkunity.com/>

config ALIGNMENT_TRAP
	def_bool y
	help
	  UniCore processors can not fetch/store information which is not
	  naturally aligned on the bus, i.e., a 8 byte fetch must start at an
	  address divisible by 8. However, this is necessary for correct
	  operation of some network protocols.

config SWIOTLB
	def_bool y

config IOMMU_HELPER
	def_bool SWIOTLB

config NEED_SG_DMA_LENGTH
	def_bool SWIOTLB
```
